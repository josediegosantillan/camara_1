## sdkconfig.defaults
```kconfig
# --- MEMORIA RAM Y VELOCIDAD (HARDWARE) ---
CONFIG_ESP32_SPIRAM_SUPPORT=y
CONFIG_SPIRAM_MODE_OCT=n
CONFIG_SPIRAM_SPEED_80M=y
CONFIG_ESPTOOLPY_FLASHFREQ_80M=y
CONFIG_SPIRAM_CACHE_WORKAROUND=y
CONFIG_OV2640_SUPPORT=y
CONFIG_ESP32_DEFAULT_CPU_FREQ_240=y

# --- OPTIMIZACIÓN DE LA PILA TCP/IP (EL SECRETO) ---
# Agrandamos la ventana TCP para que el router no nos frene
CONFIG_LWIP_TCP_WND_DEFAULT=32768
CONFIG_LWIP_TCP_SND_BUF_DEFAULT=32768

# Optimizaciones de memoria para red
CONFIG_LWIP_MAX_ACTIVE_TCP=16
CONFIG_LWIP_MAX_SOCKETS=16
CONFIG_LWIP_SO_RCVBUF=y
CONFIG_LWIP_IRAM_OPTIMIZATION=y

# Mover buffers de WiFi a la PSRAM (tenemos 4MB, usémoslos)
CONFIG_SPIRAM_TRY_ALLOCATE_WIFI_LWIP=y

# --- OPTIMIZACIÓN DEL SERVIDOR HTTP ---
# Permitir headers más grandes y respuesta rápida
CONFIG_HTTPD_MAX_REQ_HDR_LEN=1024
CONFIG_HTTPD_ERR_RESP_NO_DELAY=y
```
